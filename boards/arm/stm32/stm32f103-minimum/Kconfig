## boards/arm/stm32/stm32f103-minimum/Kconfig
```kconfig
#
# For a description of the syntax of this configuration file,
# see the file kconfig-language.txt in the NuttX tools repository.
#

if ARCH_BOARD_STM32F103_MINIMUM

choice
	prompt "Board type"
	default STM32F103MINIMUM_BLUEPILL

config STM32F103MINIMUM_BLUEPILL
	bool "Blue Pill/Red Pill/RoboDyn Black Pill"

config STM32F103MINIMUM_BLACKPILL
	bool "Black Pill"

endchoice

config STM32F103MINIMUM_AT24_BLOCKMOUNT
	bool "AT24 Serial EEPROM auto-mount"
	default n
	depends on NSH_ARCHINIT && STM32_I2C1 && MTD_AT24XX
	---help---
		Automatically initialize the AT24 I2C EEPROM driver when NSH starts.

choice
	prompt "AT24 serial EPPROM configuration"
	default STM32F103MINIMUM_AT24_FTL
	depends on STM32F103MINIMUM_AT24_BLOCKMOUNT

config STM32F103MINIMUM_AT24_FTL
	bool "Create AT24 block driver"
	---help---
		Create the MTD driver for the AT24 and "wrap" the AT24 as a standard
		block driver that could then, for example, be mounted using FAT or
		any other file system.  Any file system may be used, but there will
		be no wear-leveling.

config STM32F103MINIMUM_AT24_NXFFS
	bool "Create AT24 NXFFS file system"
	depends on FS_NXFFS
	---help---
		Create the MTD driver for the AT24 and mount the AT24 device as
		a wear-leveling, NuttX FLASH file system (NXFFS).  The downside of
		NXFFS is that it can be very slow.

endchoice # AT24 serial EPPROM configuration

config STM32F103MINIMUM_FLASH
	bool "MTD driver for external 4Mbyte W25Q32FV FLASH on SPI1"
	default n
	select MTD
	select MTD_W25
	select MTD_SMART
	select FS_SMARTFS
	select STM32_SPI1
	select MTD_BYTE_WRITE
	---help---
		Configures an MTD device for use with the onboard flash

config STM32F103MINIMUM_FLASH_MINOR
	int "Minor number for the FLASH /dev/smart entry"
	default 0
	depends on STM32F103MINIMUM_FLASH
	---help---
		Sets the minor number for the FLASH MTD /dev entry

config STM32F103MINIMUM_FLASH_PART
	bool "Enable partition support on FLASH"
	default y
	depends on STM32F103MINIMUM_FLASH
	select MTD_PARTITION
	---help---
		Enables creation of partitions on the FLASH

config STM32F103MINIMUM_FLASH_CONFIG_PART
	bool "Create application config data partition on FLASH"
	default n
	depends on STM32F103MINIMUM_FLASH_PART
	depends on PLATFORM_CONFIGDATA
	---help---
		Enables creation of a /dev/config partition on the FLASH

config STM32F103MINIMUM_FLASH_CONFIG_PART_NUMBER
	int "Index number of config partition (in list below)"
	default 0
	depends on STM32F103MINIMUM_FLASH_CONFIG_PART
	---help---
		Specifies the index number of the config data partition
		from the partition list.

config STM32F103MINIMUM_FLASH_PART_LIST
	string "Flash partition size list"
	default "1024,1024,1024,1024"
	depends on STM32F103MINIMUM_FLASH_PART
	---help---
		Comma separated list of partition sizes in KB.

config STM32F103MINIMUM_FLASH_PART_NAMES
	string "Flash partition name list"
	default "first,second,third,forth"
	depends on STM32F103MINIMUM_FLASH_PART
	depends on MTD_PARTITION_NAMES
	---help---
		Comma separated list of partition names.

config STM32F103MINIMUM_QETIMER
	int "Timer to use with QE encoder"
	default 4
	depends on SENSORS_QENCODER

menuconfig STM32_FLASH_MOUNT
	bool "Enable STM32 FLASH partitioning and mounting"
	depends on !DISABLE_MOUNTPOINT
	select MTD
	select MTD_PROGMEM
	select MTD_PARTITION
	select MTD_PARTITION_NAMES
	select FS_PROCFS
	default n
	---help---
		When enabled, you will be able to configure partition table
		for onboard FLASH memory to create and mount flash filesystems.
		All partition sizes are specified in PAGE_SIZE size. On
		STM32 page size is always 2048.

		On STM32WL55JC there are 128 pages of flash memory. Size of
		all configured partitions shall not exceed 128. In fact, it
		should be equal to 128 or else you will simply have unused
		space on flash. Even if you want some raw flash access you
		should specify this partition in table and select fs_raw.

		By default there are only 4 partitions defined, if you need
		more, you can define more in Kconfig and stm32_flash.c files.

if STM32_FLASH_MOUNT

comment "FLASH partitioning and mounting requires !DISABLE_MOUNTPOINT"
	depends on DISABLE_MOUNTPOINT

config STM32_FLASH_BL_PROG_SIZE
	int "Size reserved for bootloader program code"
	default 0
	---help---
		How much memory to reserve for bootloader program code.
		If you are using bootloader in your application, specify
		max size of bootloader partition. This memory will be
		reserved at the beginning of flash, and CPU1 progmem will
		be right after bootloader.

		If you don't use bootloader and just want to run program
		directly after reset, set this to 0.

config STM32_FLASH_CPU1_PROG_SIZE
	int "Size reserved for CPU1 program code"
	default 127
	---help---
		How much memory to reserve for CPU1 program code. This should
		specified as other partitions will be created at offset to
		this partition.

config STM32_FLASH_CPU2_PROG_SIZE
	int "Size reserved for CPU2 program code"
	default 0
	---help---
		How much memory to reserve for CPU2 program code. If you use
		dual CPU you should specify how much memory you want to
		reserve for code for second CPU. User partition will be
		created at this offset. If you don't use CPU2, set this to 0.

config STM32_FLASH_PART1_SIZE
	int "Size of user partition 1"
	default 1
	---help---
		Size of partition specified in PAGE_SIZE. Page size on
		stm32wl5xxx is always 2048.

config STM32_FLASH_PART1_NAME
	string "Name of user partition 1"
	default "part1"
	---help---
		MTD partition name, this can be later read by MTD API,
		or it can also be read from /proc/partitions to easily
		identify partitions.

config STM32_FLASH_PART1_MNT
	string "Mount point for user partition 1"
	default "/mnt/part1"
	---help---
		Directory where filesystem should be mounted.

		Note: not all filesystems can be mounted. rawfs and
		mtdconfig for example cannot be mounted. In that case
		this config will be ignored.

config STM32_FLASH_PART1_FS
	string
	default "rawfs" if STM32_FLASH_PART1_FS_RAWFS
	default "nxffs" if STM32_FLASH_PART1_FS_NXFFS
	default "smartfs" if STM32_FLASH_PART1_FS_SMARTFS
	default "mtdconfig" if STM32_FLASH_PART1_FS_MTDCONFIG

choice
	prompt "Filesystem of user partition 1"
	default STM32_FLASH_PART1_FS_RAWFS

config STM32_FLASH_PART1_FS_RAWFS
	bool "rawfs"
	---help---
		Raw block device /dev/mtdblockN will be available to use
		with standard open(2)/fopen(3) functions.

config STM32_FLASH_PART1_FS_NXFFS
	select FS_NXFFS
	bool "nxffs"
	---help---
		Partition will be used as nxffs. Only one nxffs partition
		can be enabled at one given time!

config STM32_FLASH_PART1_FS_SMARTFS
	select FS_SMARTFS
	select MTD_SMART
	bool "smartfs"
	---help---
		Partition will be used as smartfs. After first flash, you
		will have to format partition with "mksmartfs /dev/smartN"
		command. This has to be done only once unless you change
		partition table that would affect offsets and/or sizes.
		Programmers (like openocd) should not touch this memory
		when flashing new software, unless you exceeded reserved
		memory for program code.

		Smartfs uses quite substential amount of FLASH data to
		get to workable state and mount. Looks like 8 page sizes
		is absolute minimum (so a 16KiB!).

config STM32_FLASH_PART1_FS_MTDCONFIG
	select MTD_CONFIG
	bool "mtdconfig"
	---help---
		Purpose build filesystem to hold application's configuration.
		It's not a filesystem per se, as it cannot be mounted and
		setting and retrieving configuration is done via ioctl(2)
		calls.

endchoice # Filesystem of user partition 1

config STM32_FLASH_PART2_SIZE
	int "Size of user partition 2"
	default 0

if STM32_FLASH_PART2_SIZE > 0

config STM32_FLASH_PART2_NAME
	string "Name of user partition 2"
	default "part2"

config STM32_FLASH_PART2_MNT
	string "Mount point for user partition 2"
	default "/mnt/part2"

config STM32_FLASH_PART2_FS
	string
	default "rawfs" if STM32_FLASH_PART2_FS_RAWFS
	default "nxffs" if STM32_FLASH_PART2_FS_NXFFS
	default "smartfs" if STM32_FLASH_PART2_FS_SMARTFS
	default "mtdconfig" if STM32_FLASH_PART2_FS_MTDCONFIG

choice
	prompt "Filesystem of user partition 2"
	default STM32_FLASH_PART2_FS_RAWFS

config STM32_FLASH_PART2_FS_RAWFS
	bool "rawfs"

config STM32_FLASH_PART2_FS_NXFFS
	select FS_NXFFS
	bool "nxffs"

config STM32_FLASH_PART2_FS_SMARTFS
	select FS_SMARTFS
	select MTD_SMART
	bool "smartfs"

config STM32_FLASH_PART2_FS_MTDCONFIG
	select MTD_CONFIG
	bool "mtdconfig"

endchoice # Filesystem of user partition 2

config STM32_FLASH_PART3_SIZE
	int "Size of user partition 3"
	default 0

if STM32_FLASH_PART3_SIZE > 0

config STM32_FLASH_PART3_NAME
	string "Name of user partition 3"
	default "part3"

config STM32_FLASH_PART3_MNT
	string "Mount point for user partition 3"
	default "/mnt/part3"

config STM32_FLASH_PART3_FS
	string
	default "rawfs" if STM32_FLASH_PART3_FS_RAWFS
	default "nxffs" if STM32_FLASH_PART3_FS_NXFFS
	default "smartfs" if STM32_FLASH_PART3_FS_SMARTFS
	default "mtdconfig" if STM32_FLASH_PART3_FS_MTDCONFIG

choice
	prompt "Filesystem of user partition 3"
	default STM32_FLASH_PART3_FS_RAW

config STM32_FLASH_PART3_FS_RAWFS
	bool "rawfs"

config STM32_FLASH_PART3_FS_NXFFS
	select FS_NXFFS
	bool "nxffs"

config STM32_FLASH_PART3_FS_SMARTFS
	select FS_SMARTFS
	select MTD_SMART
	bool "smartfs"

config STM32_FLASH_PART3_FS_MTDCONFIG
	select MTD_CONFIG
	bool "mtdconfig"

endchoice # Filesystem of user partition 3

config STM32_FLASH_PART4_SIZE
	int "Size of user partition 4"
	default 0

if STM32_FLASH_PART4_SIZE > 0

config STM32_FLASH_PART4_NAME
	string "Name of user partition 4"
	default "part4"

config STM32_FLASH_PART4_MNT
	string "Mount point for user partition 4"
	default "/mnt/part4"

config STM32_FLASH_PART4_FS
	string
	default "rawfs" if STM32_FLASH_PART4_FS_RAWFS
	default "nxffs" if STM32_FLASH_PART4_FS_NXFFS
	default "smartfs" if STM32_FLASH_PART4_FS_SMARTFS
	default "mtdconfig" if STM32_FLASH_PART4_FS_MTDCONFIG

choice
	prompt "Filesystem of user partition 4"
	default STM32_FLASH_PART4_FS_RAW

config STM32_FLASH_PART4_FS_RAWFS
	bool "rawfs"

config STM32_FLASH_PART4_FS_NXFFS
	select FS_NXFFS
	bool "nxffs"

config STM32_FLASH_PART4_FS_SMARTFS
	select FS_SMARTFS
	select MTD_SMART
	bool "smartfs"

config STM32_FLASH_PART4_FS_MTDCONFIG
	select MTD_CONFIG
	bool "mtdconfig"

endchoice # Filesystem of user partition 4

endif # STM32_FLASH_PART2_SIZE > 0
endif # STM32_FLASH_PART3_SIZE > 0
endif # STM32_FLASH_PART4_SIZE > 0

endif # STM32_FLASH_MOUNT

endif
```
